#include "clock.h"
#include <pluginlib/class_list_macros.h>
#include <QtCore/QStringList>
#include <std_msgs/String.h>
#include <ros/ros.h>

namespace my_clock {

clock::clock():
    rqt_gui_cpp::Plugin(),
    widget_(0),
    ui_(NULL),
    seconds(0),
    minutes(0),
    timer(NULL),
    run_timer(false),
    time_sig1(60),
    time_sig2(60)
{

  // Constructor is called first before initPlugin function, needless to say.
  //widget_ = new QWidget();

  // give QObjects reasonable names
  setObjectName("Clock");
}

void clock::initPlugin(qt_gui_cpp::PluginContext& context)
{
  QStringList argv = context.argv();

  widget_ = new QWidget();

  ui_ = new Ui::Form;
  ui_->setupUi(widget_);
  context.addWidget(widget_);
  //ui_->lcdNumber->setDecMode();

  timer = new QTimer(this);
  connect(timer, SIGNAL(timeout()), this, SLOT(updateClock()));
  timer->start(1000); // generate timeout after 1000ms

  connect(ui_->pushButton, SIGNAL(clicked()), this, SLOT(button_start_stop()));   // signal button "StartStop"
  connect(ui_->pushButton_2, SIGNAL(clicked()), this, SLOT(button_reset())); // signal button "Reset"
}

void clock::shutdownPlugin()
{
  // TODO unregister all publishers here
  //_pub.shutdown();
}

void clock::saveSettings(qt_gui_cpp::Settings& plugin_settings, qt_gui_cpp::Settings& instance_settings) const
{
  // TODO save intrinsic configuration, usually using:
  // instance_settings.setValue(k, v)
}

void clock::restoreSettings(const qt_gui_cpp::Settings& plugin_settings, const qt_gui_cpp::Settings& instance_settings)
{
  // TODO restore intrinsic configuration, usually using:
  // v = instance_settings.value(k)
}

/*bool hasConfiguration() //const
{
  return true;
}

void triggerConfiguration()
{
  // Usually used to open a dialog to offer the user a set of configuration
}*/


// Routine executed after every timeout signal generated by the timer
void clock::updateClock(void)
{
  if(run_timer == true)
  {
    // increment "time value"
    if(++seconds >= 60)
    {
      seconds = 0;
      minutes++;
    }

    // change background color when reaching value of Sig1
    if(minutes == time_sig1)
    {
      ui_->lcdNumber->setStyleSheet(QString::fromUtf8("background-color: rgb(255, 255, 0);"));
      ui_->lcdNumber_2->setStyleSheet(QString::fromUtf8("background-color: rgb(255, 255, 0);"));
    }

    // change background color when reaching value of Sig2
    if(minutes == time_sig2)
    {
      ui_->lcdNumber->setStyleSheet(QString::fromUtf8("background-color: rgb(255, 100, 0);"));
      ui_->lcdNumber_2->setStyleSheet(QString::fromUtf8("background-color: rgb(255, 100, 0);"));
    }

    // refresh display
    ui_->lcdNumber->display((int)minutes);
    ui_->lcdNumber_2->display((int)seconds);

    // stop and reset clock if maximal clock value is reached
    if(minutes == 99 && seconds == 59)
    {
      clock::button_start_stop();
      clock::button_reset();
    }
  }
}


// Routine executed after every "clicked" signal generated by button "Start"
void clock::button_start_stop(void)
{
  // if timer is NOT active: activate timer
  if(!run_timer)
  {
    //if timer is in state reset: read values Sig1 and Sig2 from spinBox and spinBox_2 and disable spinBoxes while timer is running
    if(minutes == 0 && seconds == 0)
    {
      time_sig1 = ui_->spinBox->value();
      time_sig2 = ui_->spinBox_2->value();
      ui_->spinBox->setEnabled(false);
      ui_->spinBox_2->setEnabled(false);
    }
    run_timer = true; //activate timer
    ui_->pushButton->setText(QApplication::translate("Form", "Stop", 0)); //change button label to "Stop"
    ui_->pushButton->setStyleSheet(QString::fromUtf8("background-color: rgb(255, 100, 100);")); //change button background color to red
    ui_->pushButton_2->setEnabled(false);
  }
  else //if timer is active: deactivate timer
  {
    run_timer = false;
    ui_->pushButton->setText(QApplication::translate("Form", "Start", 0)); //change button label to "Start"
    ui_->pushButton->setStyleSheet(QString::fromUtf8("background-color: rgb(100, 255, 100);")); //change button background color to green
    ui_->pushButton_2->setEnabled(true);
  }
}


// Routine executed after every "clicked" signal generated by button_3 "Reset"
void clock::button_reset(void)
{
  // reset values for minutes and seconds
  seconds = 0;
  minutes = 0;
  // if timer is NOT active: enable spinBoxes for entering time values for Sig1 and Sig2
  if(!run_timer)
  {
    ui_->spinBox->setEnabled(true);
    ui_->spinBox_2->setEnabled(true);
  }
  // refresh display (values and background color)
  ui_->lcdNumber->display((int)minutes);
  ui_->lcdNumber_2->display((int)seconds);
  ui_->lcdNumber->setStyleSheet(QString::fromUtf8("background-color: rgb(255, 255, 255);"));
  ui_->lcdNumber_2->setStyleSheet(QString::fromUtf8("background-color: rgb(255, 255, 255);"));
}


} // namespace
PLUGINLIB_EXPORT_CLASS(my_clock::clock, rqt_gui_cpp::Plugin)
